## boards/arm/supermini_nrf/Kconfig.board
```kconfig
# nice!nano board configuration

# Copyright (c) 2020 Pete Johanson
# SPDX-License-Identifier: MIT

config BOARD_SUPERMINI_NRF
    bool "supermini nrf"
    depends on SOC_NRF52840_QIAA
```
